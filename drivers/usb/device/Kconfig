## drivers/usb/device/Kconfig.wch
```kconfig
# Copyright (c) 2026 carrefinho
# SPDX-License-Identifier: Apache-2.0

config USB_DC_WCH
	bool "WCH USBFS device controller driver (legacy usb_dc stack)"
	default y
	depends on DT_HAS_WCH_USBFS_ENABLED || DT_HAS_WCH_CH32X035_USBFS_ENABLED
	depends on USB_DEVICE_DRIVER
	help
	  Legacy (CONFIG_USB_DEVICE_STACK) driver for the WCH full-speed USB
	  device controllers: the V20x/V30x "USBHD" block (wch,usbfs) and the
	  X03x device-only block (wch,ch32x035-usbfs). The block is selected
	  at build time from devicetree.

if USB_DC_WCH

config USB_DC_WCH_STACK_SIZE
	int "Callback thread stack size"
	default 1024
	help
	  Stack size for the thread that runs the stack's endpoint and status
	  callbacks outside ISR context.

config USB_DC_WCH_THREAD_PRIORITY
	int "Callback thread cooperative priority"
	default 2
	help
	  Cooperative priority of the deferred callback thread.

config USB_DC_WCH_MAX_QMESSAGES
	int "Maximum number of queued ISR events"
	range 4 64
	default 8
	help
	  Depth of the message queue carrying events from the USB ISR to the
	  callback thread.

config USB_DC_WCH_VDD_5V
	bool "Board runs the USB PHY from a 5V VDD"
	depends on DT_HAS_WCH_CH32X035_USBFS_ENABLED
	help
	  On the CH32X03x the D+ pull-up strength and the internal 3.3V PHY LDO
	  depend on the supply rail. Leave this unset for a 3.3V VDD (PHY LDO
	  enabled, 1.5K pull-up); set it for a 5V VDD (no LDO, 10K pull-up).

endif # USB_DC_WCH
```

## drivers/usb/udc/Kconfig.wch
```kconfig
# Copyright (c) 2023 Nordic Semiconductor ASA
# SPDX-License-Identifier: Apache-2.0

config UDC_WCH
	bool "WCH USB device controller driver"
	default y
	depends on DT_HAS_WCH_USBFS_ENABLED && UDC_DRIVER
	help
	  WCH USB device controller driver.

config UDC_WCH_STACK_SIZE
	int "UDC controller driver internal thread stack size"
	depends on UDC_WCH
	default 512
	help
	  WCH USB device controller driver internal thread stack size.

config UDC_WCH_THREAD_PRIORITY
	int "WCH USB controller driver thread priority"
	depends on UDC_WCH
	default 8
	help
	  WCH USB device controller driver thread priority.

config UDC_WCH_MAX_QMESSAGES
	int "WCH UDC driver maximum number of ISR event messages"
	range 4 64
	default 8
	help
	  Maximum number of messages for handling of WCH USBD ISR events.

config UDC_WCH_X03X
	bool "WCH CH32X035 USBFS device controller driver"
	default y
	depends on DT_HAS_WCH_CH32X035_USBFS_ENABLED && UDC_DRIVER
	help
	  device-next (udc_api) driver for the CH32X03x USBFS device
	  controller.

config UDC_WCH_X03X_STACK_SIZE
	int "CH32X035 UDC driver internal thread stack size"
	depends on UDC_WCH_X03X
	default 512
	help
	  CH32X035 USBFS device controller driver internal thread stack size.

config UDC_WCH_X03X_THREAD_PRIORITY
	int "CH32X035 UDC controller driver thread priority"
	depends on UDC_WCH_X03X
	default 8
	help
	  CH32X035 USBFS device controller driver thread priority.

config UDC_WCH_X03X_MAX_QMESSAGES
	int "CH32X035 UDC driver maximum number of ISR event messages"
	depends on UDC_WCH_X03X
	range 4 64
	default 8
	help
	  Maximum number of messages for handling of CH32X035 USBFS ISR events.
```

## dts/bindings/clock/wch,ch32v20x_30x-pll-clock.yaml
```yaml
# Copyright (c) 2024 MASSDRIVER EI (massdriver.space)
# SPDX-License-Identifier: Apache-2.0

description: WCH CH32V20x/30x PLL

compatible: "wch,ch32v20x_30x-pll-clock"

include: [clock-controller.yaml, base.yaml]

properties:
  "#clock-cells":
    const: 0

  clocks:
    type: phandle-array
    required: true

  hsi-pre-div:
    type: int
    default: 1
    description: |
        Divider applied to the HSI before it reaches the PLL, selected by
        EXTEN_CTR PLL_HSI_PRE. Only meaningful when the PLL is clocked from
        the HSI; ignored for an HSE-sourced PLL.

        1 feeds the PLL the full HSI (the vendor SDK's choice for its
        high-frequency recipes, e.g. 8 MHz x18 = 144 MHz) and 2 feeds it
        HSI/2, which is the hardware reset state.

        The default is 1 so that "mul" multiplies the HSI frequency as
        written. Note this bit is NOT restored by a warm reset, so a driver
        that does not write it inherits whatever the bootloader or the
        previously running image left -- which made SYSCLK differ between
        boots of the same image before this property existed.
    enum:
      - 1
      - 2

  mul:
    type: int
    required: true
    description: |
        Main PLL multiplication factor
    enum:
      - 2   # x2
      - 3   # x3
      - 4   # x4
      - 5   # x5
      - 6   # x6
      - 7   # x7
      - 8   # x8
      - 9   # x2
      - 10  # x10
      - 11  # x11
      - 12  # x12
      - 13  # x13
      - 14  # x14
      - 15  # x15
      - 16  # x16
      - 18  # x18
```

## dts/bindings/flash_controller/wch,ch32v20x_30x-flash-controller.yaml
```yaml
# Copyright (c) 2026 carrefinho
# SPDX-License-Identifier: Apache-2.0

description: WCH CH32V20x/30x flash controller (FPEC)

compatible: "wch,ch32v20x_30x-flash-controller"

include: flash-controller.yaml
```

## dts/bindings/flash_controller/wch,ch32x03x-flash-controller.yaml
```yaml
# Copyright (c) 2026 carrefinho
# SPDX-License-Identifier: Apache-2.0

description: |
  WCH CH32X03x flash controller (FPEC).

  Scaffold binding only: there is no matching flash driver yet, this exists so
  the flash-controller node and its soc-nv-flash child compile and can back the
  chosen zephyr,flash partition.

compatible: "wch,ch32x03x-flash-controller"

include: flash-controller.yaml
```

## dts/bindings/usb/wch,ch32x035-usbfs.yaml
```yaml
# Copyright (c) 2026 carrefinho
# SPDX-License-Identifier: Apache-2.0

description: |
  WCH CH32X03x USBFS device controller.

  Distinct from "wch,usbfs" (the V20x/V30x USBHD/USBOTG_FS controller): the
  X03x has a device-only register map at 0x40023400, no UEP4 DMA register, one
  control byte per endpoint for both directions, and its USB PHY analog
  controls live in AFIO->CTLR rather than the endpoint block. It is handled by
  udc_wch_x03x.c (device-next) and the X03x path of usb_dc_wch.c (legacy).

  Two clocks are required and must be listed in order: the USBFS AHB gate
  first, then the AFIO gate (the driver writes AFIO->CTLR to enable the PHY).

compatible: "wch,ch32x035-usbfs"

include: usb-ep.yaml

properties:
  reg:
    required: true

  interrupts:
    required: true

  clocks:
    required: true
    description: |
      USBFS gate (AHB) as clocks[0], AFIO gate (APB2) as clocks[1].

  wch,vdd-5v:
    type: boolean
    description: |
      Set when the part runs from a 5V VDD. Selects the 10K D+ pull-up and
      disables the internal 3.3V PHY LDO. When unset (default, 3.3V VDD) the
      internal PHY LDO is enabled and a 1.5K D+ pull-up is used.
```

## soc/wch/ch32v/Kconfig.soc
```kconfig
# Copyright (c) 2024 Michael Hope
# Copyright (c) 2024 Jianxiong Gu
# Copyright (c) 2026 carrefinho
# SPDX-License-Identifier: Apache-2.0

config SOC_FAMILY_CH32VX
	bool

config SOC_FAMILY
	default "ch32vx" if SOC_FAMILY_CH32VX

rsource "*/Kconfig.soc"
```

## soc/wch/ch32v/qingke_v4c/Kconfig.defconfig.ch32x035
```kconfig
# Copyright (c) 2025 MASSDRIVER EI (massdriver.space)
# Copyright (c) 2026 carrefinho
# SPDX-License-Identifier: Apache-2.0

if SOC_CH32X035

config VECTOR_TABLE_SIZE
	default 60

config NUM_IRQS
	default 60

endif # SOC_CH32X035
```

## soc/wch/ch32v/qingke_v4c/Kconfig.soc.ch32x035
```kconfig
# Copyright (c) 2025 MASSDRIVER EI (massdriver.space)
# Copyright (c) 2026 carrefinho
# SPDX-License-Identifier: Apache-2.0

config SOC_CH32X035
	bool
	select SOC_SERIES_QINGKE_V4C

config SOC
	default "ch32x035" if SOC_CH32X035
```
